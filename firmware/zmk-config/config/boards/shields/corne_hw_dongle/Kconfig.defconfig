## firmware/zmk-config/config/boards/shields/corne_hw_dongle/Kconfig.defconfig
```kconfig
if SHIELD_CORNE_HW_DONGLE

config ZMK_SPLIT
	def_bool y

config ZMK_SPLIT_ROLE_CENTRAL
	def_bool y

config ZMK_KEYBOARD_NAME
	default "Sputnik Dongle"

endif
```

## firmware/zmk-config/config/boards/shields/corne_hw_dongle/Kconfig.shield
```kconfig
config SHIELD_CORNE_HW_DONGLE
	def_bool $(shields_list_contains,corne_hw_dongle)
```

## firmware/zmk-config/config/boards/shields/corne_hw_left/Kconfig.defconfig
```kconfig
if SHIELD_CORNE_HW_LEFT

config ZMK_SPLIT
	def_bool y

config ZMK_SPLIT_ROLE_CENTRAL
	def_bool n

endif
```
